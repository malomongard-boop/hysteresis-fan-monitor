## CMakeLists.txt
```
cmake_minimum_required(VERSION 3.20.0)
find_package(Zephyr REQUIRED HINTS $ENV{ZEPHYR_BASE})
project(hysteresis_fan_monitor VERSION 0.1.0 LANGUAGES CXX)

target_include_directories(app PRIVATE include)

target_sources(app PRIVATE
    src/main.cpp
    src/sensor_task.cpp
    src/regulator_task.cpp
    src/actuator_task.cpp
)
```

## prj.conf
```kconfig
# C++ support
CONFIG_CPP=y
CONFIG_STD_CPP20=y
CONFIG_REQUIRES_FULL_LIBC=y

# Threading
CONFIG_MAIN_STACK_SIZE=2048
CONFIG_SYSTEM_WORKQUEUE_STACK_SIZE=2048

# Logging 
CONFIG_PRINTK=y
```

## src/main.cpp
```c
#include <zephyr/kernel.h>
#include <zephyr/version.h>

int main()
{
    printk("=== Hysteresis Fan Monitor ===\n");
    printk("Zephyr version: %s\n", KERNEL_VERSION_STRING);
    return 0;
}
```

## include/tasks.hpp
```c
#pragma once

#include <zephyr/kernel.h>

struct SensorMessage 
{
    int32_t value {}; // simulated raw temperature value
    int64_t timestamp {}; // acquisition timestamp (ms)
};

enum FanState
{
    FAN_OFF,
    FAN_ON
};
struct RegulatorMessage 
{
    FanState fan_command {}; // command to turn the fan on or off
    int64_t timestamp {}; // command timestamp (ms)
};

// Stack sizes
constexpr int SENSOR_STACK_SIZE {2048};
constexpr int REGULATOR_STACK_SIZE {2048};
constexpr int ACTUATOR_STACK_SIZE {2048};

// Task priorities (lower value = higher priority)
constexpr int SENSOR_PRIORITY {5};
constexpr int REGULATOR_PRIORITY {6};
constexpr int ACTUATOR_PRIORITY {7};

// Message queue depths
constexpr int TEMP_QUEUE_DEPTH {10};
constexpr int CMD_QUEUE_DEPTH {10};

// Acquisition period in milliseconds
constexpr int ACQUISITION_PERIOD_MS {200};
```

## src/actuator_task.cpp
```c
#include <zephyr/kernel.h>
#include "tasks.hpp"

extern struct k_msgq cmd_queue; // Message queue from regulator task
static int onOff_counter {0};

void actuator_task(void*, void*, void*)
{
    printk("[ACTUATOR] Task started\n");

    RegulatorMessage msgFromRegulator {};

    while (true)
    {
        if (k_msgq_get(&cmd_queue, &msgFromRegulator, K_FOREVER) == 0)
        {
            if (msgFromRegulator.fan_command == FAN_ON)
            {
                onOff_counter++;
                printk("[ACTUATOR] Received command to turn FAN ON at %lldms\n", msgFromRegulator.timestamp);
            }
            else
            {
                printk("[ACTUATOR] Received command to turn FAN OFF at %lldms\n", msgFromRegulator.timestamp);
            }

            if (onOff_counter % 10 == 0 && msgFromRegulator.fan_command == FAN_ON) // Print status every 10 commands
            {
                printk("[ACTUATOR] Fan ON/OFF counter: %d\n", onOff_counter);
            }
        }
    }
}

K_THREAD_DEFINE(
    actuator_tid, // Thread ID
    ACTUATOR_STACK_SIZE, // Stack size
    actuator_task, // Thread entry function
    NULL, NULL, NULL, // No arguments
    ACTUATOR_PRIORITY, // Thread priority
    0, // Options
    0 // Delay (start immediately)
);
```

## src/regulator_task.cpp
```c
#include <zephyr/kernel.h>
#include "tasks.hpp"

K_MSGQ_DEFINE(cmd_queue, sizeof(RegulatorMessage), CMD_QUEUE_DEPTH, 4); // Message queue to actuator task

extern struct k_msgq temp_queue; // Message queue from sensor task

static int32_t s_min_threshold {65};
static int32_t s_max_threshold {75};
static k_mutex s_threshold_mutex {};

// Thread-safe API to update the regulator thresholds at runtime
void regulator_set_thresholds(int32_t min, int32_t max)
{
    k_mutex_lock(&s_threshold_mutex, K_FOREVER);
    s_min_threshold = min;
    s_max_threshold = max;
    k_mutex_unlock(&s_threshold_mutex);
}

static FanState s_current_fan_state {FAN_OFF};

void regulator_task(void*, void*, void*)
{
    k_mutex_init(&s_threshold_mutex);
    
    printk("[REGULATOR] Task started\n");

    SensorMessage msgFromSensor {};
    RegulatorMessage msgToActuator {};
    int32_t min_threshold {};
    int32_t max_threshold {};

    while (true)
    {
        if(k_msgq_get(&temp_queue, &msgFromSensor, K_FOREVER) == 0)
        {
            // Read thresholds under mutex to prevent partial reads
            k_mutex_lock(&s_threshold_mutex, K_FOREVER);
            min_threshold = s_min_threshold;
            max_threshold = s_max_threshold;
            k_mutex_unlock(&s_threshold_mutex);

            // Hysteresis control logic
            if (msgFromSensor.value >= max_threshold && s_current_fan_state == FAN_OFF)
            {
                s_current_fan_state = FAN_ON;
                msgToActuator.fan_command = FAN_ON;
            }
            else if (msgFromSensor.value <= min_threshold && s_current_fan_state == FAN_ON)
            {
                s_current_fan_state = FAN_OFF;
                msgToActuator.fan_command = FAN_OFF;
            }
            else
            {
                // No change, skip sending command
                continue;
            }

            msgToActuator.timestamp = msgFromSensor.timestamp; // Use sensor timestamp for better correlation

            // Send the command to the actuator task, with a timeout to avoid blocking indefinitely
            if (k_msgq_put(&cmd_queue, &msgToActuator, K_MSEC(10)) != 0)
            {
                printk("[REGULATOR] Warning: cmd_queue full, command dropped\n");
            }
        }
    }
}

K_THREAD_DEFINE(
    regulator_tid,
    REGULATOR_STACK_SIZE,
    regulator_task,
    NULL, NULL, NULL,
    REGULATOR_PRIORITY,
    0,
    0
);
```

## src/sensor_task.cpp
```c
#include "tasks.hpp"
#include <zephyr/kernel.h>

K_MSGQ_DEFINE(temp_queue, sizeof(SensorMessage), TEMP_QUEUE_DEPTH, 4); // Message queue to regulator task
K_SEM_DEFINE(sensor_sem, 0, 1); // Semaphore signaled by the timer ISR to trigger acquisition

// Temperature fluctuations simulation
static int32_t s_temperature {20};

// Timer callback — runs in ISR context
// Only signals the semaphore; actual work is done in the task
static void sensor_callback([[maybe_unused]]struct k_timer *timer)
{
    k_sem_give(&sensor_sem);
}

K_TIMER_DEFINE(sensor_timer, sensor_callback, NULL); // Timer for periodic acquisition

// Task that simulate the temperature changes and send raw data to the regulator task
void sensor_task(void*, void*, void*)
{
    printk("[SENSOR] Task started, period=%dms\n", ACQUISITION_PERIOD_MS);
    k_timer_start(&sensor_timer,
                  K_MSEC(ACQUISITION_PERIOD_MS),
                  K_MSEC(ACQUISITION_PERIOD_MS));

    while (true)
    {
        k_sem_take(&sensor_sem, K_FOREVER);
        SensorMessage msg {};
        msg.value = s_temperature;
        msg.timestamp = k_uptime_get();

        // Simulate temperature changes with a simple pattern: increase until 90, then reset to 20
        if (s_temperature >= 90)
        {
            s_temperature = 20; // reset to minimum        
        }
        else
        {
            s_temperature++; // increase temperature
        }

        // Send the message to the regulator task, with a timeout to avoid blocking indefinitely
        if (k_msgq_put(&temp_queue, &msg, K_MSEC(10)) != 0)
        {
            printk("[SENSOR] Warning: queue full, message dropped\n");
        }
    }
    k_timer_stop(&sensor_timer);
}

// Static thread declaration — stack and TCB allocated at compile time
K_THREAD_DEFINE(
    sensor_tid, // Thread ID
    SENSOR_STACK_SIZE, // Stack size
    sensor_task, // Thread entry function
    NULL, NULL, NULL, // No arguments
    SENSOR_PRIORITY, // Thread priority
    0, // Options
    0 // Delay (start immediately)
);
```
